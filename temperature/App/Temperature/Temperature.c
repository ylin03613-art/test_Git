/*********************************************************************************************************
* 模块名称: Temperature.c
* 摘    要: 温度算法
* 当前版本: 1.0.0
* 作    者: 林明霞
* 完成日期:  
* 内    容:
* 注    意:                                                                   
**********************************************************************************************************
* 取代版本: 
* 作    者:
* 完成日期: 
* 修改内容:
* 修改文件: 
*********************************************************************************************************/

/*********************************************************************************************************
*                                              包含头文件
*********************************************************************************************************/
#include "Temperature.h"
#include "stm32f10x_conf.h"
#include "DataType.h"
#include "ADC.h"
#include "Timer.h"
#include "UART1.h"
#include <math.h>
#include <stdlib.h>
#include "EXTI.h"
#include "OLED.h"
#include "SysTick.h"
#include "ADC.h"
#include "U16Queue.h"
#include <string.h>
/*********************************************************************************************************
*                                              宏定义
*********************************************************************************************************/
//体温通道引脚定义
#define SENSE1 GPIO_Pin_7
#define PA     GPIO_Pin_4
#define PB     GPIO_Pin_6
#define SENS_OFF GPIO_Pin_8
//校准电阻定义
#define RA 7350
#define RB 510
/*********************************************************************************************************
*                                              枚举结构体定义
*********************************************************************************************************/

/*********************************************************************************************************
*                                              内部变量
*********************************************************************************************************/
 extern u16 s_arrADC1Data[2];
 static float c1, c2;  //体温系数
 static u8 caflag;  //校准标志位
 static u16 s_iPointCnt = 0;  //采样点数计数器
 static u32 sum = 0;         //采样点的和，用于计算平均值
 static float VA = 2.090;            //PA对应的电压
 static float VB = 0.219;           //PB对应的电压
 extern StructU16CirQue  s_structADCCirQue;            //ADC循环队列
 extern u16              s_arrADCBuf[ADC1_BUF_SIZE];   //ADC循环队列的缓冲区
  u8 leadFlag = 0;  //导联脱离标志位 1-脱离 0-未脱离
  u8 openFlag = 1;  //体温测量开启标志位 1-开启 0-关闭
 const u16 n = 502;   //数组元素个数
 float R;
 //const u16 devR = 255;  //偏差电阻
 
 static float arr_R[] = {7355.0, 7317.5, 7280.3, 7243.3, 7206.4, 7169.8, 7133.4, 7097.2, 7061.2, 7025.5, 6989.9,
 6954.5, 6919.3, 6884.3, 6849.6, 6815.0, 6780.6, 6746.4, 6712.4, 6678.6, 6645.0, 6611.6, 6578.4, 6545.3, 6512.5,
 6479.8, 6447.3, 6415.0, 6382.9, 6350.9, 6312.9, 6287.6, 6256.2, 6224.9, 6193.9, 6163.0, 6132.3, 6101.8, 6071.4,
 6041.2, 6011.2, 5981.3, 5951.6, 5922.1, 5892.8, 5863.6, 5834.5, 5805.7, 5776.9, 5748.4, 5720.0, 5691.8, 5663.7,
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 833.6, 830.5, 827.3, 824.1, 821.0, 817.9, 814.8, 811.3, 807.0}; //厂家电阻值 温度=阻值下标/10+1
 
/*********************************************************************************************************
*                                              内部函数声明
*********************************************************************************************************/
static void ConfigTempGPIO(void);   //初始化体温的相关引脚
static void ChannelSelecion(u8 type);  //体温通道选择
static float AdDataToVoltage(void);  //ad值转换为电压值
static void TempCalibration(void);  //体温校准电路
static u16 BinarySearch(float arr[], u16 n, float target);  //二分查找函数
/*********************************************************************************************************
*                                              内部函数实现
*********************************************************************************************************/
/*********************************************************************************************************
* 函数名称: ConfigTempGPIO
* 函数功能: 初始化体温的相关引脚
* 输入参数: void
* 输出参数: void
* 返 回 值: void
* 创建日期: 
* 注    意: PC7-TEMP_SENSE1 PC4-TEMP_PA PC6-TEMP_PB PC8-SENS_OFF
*********************************************************************************************************/
static void ConfigTempGPIO(void)
{
  GPIO_InitTypeDef GPIO_InitStructure;  //用于存放GPIO的参数
  
  //使能RCC相关时钟
  RCC_APB2PeriphClockCmd(RCC_APB2Periph_GPIOC,ENABLE);  //使能GPIO时钟
  
  //配置PC6,PC7,PC4
  GPIO_InitStructure.GPIO_Pin = SENSE1 | PA | PB;  //设置引脚 设置为推挽输出
  GPIO_InitStructure.GPIO_Mode = GPIO_Mode_Out_PP;  //设置模式
  GPIO_InitStructure.GPIO_Speed = GPIO_Speed_50MHz;  //设置I/O输出速度
  GPIO_Init(GPIOC,&GPIO_InitStructure);  //根据参数初始化
  GPIO_WriteBit(GPIOC ,SENSE1 | PA | PB, Bit_RESET);  //将引脚默认状态设置为低电平
  
  //配置PC8
  GPIO_InitStructure.GPIO_Pin = SENS_OFF;
  GPIO_InitStructure.GPIO_Mode = GPIO_Mode_IN_FLOATING;  //设置引脚 设置为浮空输入
  GPIO_Init(GPIOC,&GPIO_InitStructure);  //根据参数初始化
  GPIO_WriteBit(GPIOC ,SENS_OFF, Bit_RESET);  //将引脚默认状态设置为低电平
}

/*********************************************************************************************************
* 函数名称: AdDataToVoltage
* 函数功能: ad值转换为电压值
* 输入参数: void
* 输出参数: void
* 返 回 值: float voltage-ad值对应的电压
* 创建日期: 
* 注    意:
*********************************************************************************************************/
static float AdDataToVoltage(void)
{
  u16 adcData;   //adc采样数据
  static float average = 0;   //平均值
  float voltage;        //ad值对应的电压
  float V_ref; //准确的供电电压
  if(Get2msFlag())           //每2ms采一次样
  {
    adcData = (float)s_arrADC1Data[0];
      //printf("ad=%d point%d  ",adcData,s_iPointCnt);
      sum = sum + adcData;   //将之前的采样值相加
      //printf("  sum=%d ",sum);
      s_iPointCnt++;         //采样计数加1
      if(s_iPointCnt >= 350) //当采样到350个
      {
        average = sum / s_iPointCnt;  //计算采样点的平均值
        //printf("average=%0.2f\n",average);        
      }
    Clr2msFlag();   //清除0.3ms标志
  
    //V_ref = 1.2 / s_arrADC1Data[1] * 4095;
    //printf("V_ref=%0.3f\n",V_ref);
    voltage = 3.3 * average / 4095;  //ad值转化为电压值
    //printf("voltage=%0.3f\n",voltage);
  }
  return voltage;
}

/*********************************************************************************************************
* 函数名称: ChannelSelecion
* 函数功能: 体温通道选择
* 输入参数: Type-体温通道
* 输出参数: 
* 返 回 值: void
* 创建日期: 
* 注    意: 三个通道高电平通道只能有一个
*********************************************************************************************************/
static void ChannelSelecion(u8 type)
{
  switch(type)
  {
    case TEMP_SENSE1:
      GPIO_WriteBit(GPIOC, SENSE1, Bit_SET);   //体温测量通道设置为高电平
      GPIO_WriteBit(GPIOC , PA|PB, Bit_RESET); //其余通道设置为低电平
      OLEDShowString(48, 16, "open       ");
      //OLEDShowString(64, 32, "SENSE1");
      OLEDRefreshGRAM();  //刷新OLED
      openFlag = 1;  //开启体温标志位置一
    break;
    case TEMP_PA:
      GPIO_WriteBit(GPIOC, PA, Bit_SET);           //校准PA通道设置为高电平
      GPIO_WriteBit(GPIOC , SENSE1|PB, Bit_RESET); //其余通道设置为低电平
      //OLEDShowString(64, 32, "PA     ");
      //OLEDRefreshGRAM();  //刷新OLED
    break;
    case TEMP_PB:
      GPIO_WriteBit(GPIOC, PB, Bit_SET);           //体温测量通道设置为高电平
      GPIO_WriteBit(GPIOC , SENSE1|PA, Bit_RESET); //其余通道设置为低电平
     // OLEDShowString(64, 32, "PB      ");
      //OLEDRefreshGRAM();  //刷新OLED
    break;
    case CLOSE:
      GPIO_WriteBit(GPIOC ,SENSE1 | PA | PB, Bit_RESET);  //全部通道设置为低电平
//      OLEDShowString(64, 32, "--    ");
//      OLEDRefreshGRAM();  //刷新OLED
      openFlag = 0;   //开启体温通道标志位置零
    break;
  }
    
}
/*********************************************************************************************************
* 函数名称: TempCalibration
* 函数功能: 体温校准电路
* 输入参数: void
* 输出参数: c1 c2 -体温系数
* 返 回 值: void
* 创建日期: 
* 注    意:
*********************************************************************************************************/
static void TempCalibration(void)
{
  caflag = 1; //校准标志位置一
  
  OLEDShowString(48, 16, "calibrate");
  OLEDRefreshGRAM();  //刷新OLED
  
  ChannelSelecion(CLOSE);
  ChannelSelecion(TEMP_PA);  //打开校准通道PA
  printf("PA采样\n");
  s_iPointCnt = 0;     //采样点计数器置0
  sum = 0;         //采样点和置0  
  // 采样1100次，确保至少完成1100次采样
  while (s_iPointCnt <= 150)
    {
      VA = AdDataToVoltage();  // ad值转化为电压值
    }
    printf("VA=%0.3f\n",VA);
    s_iPointCnt = 0;     //采样点计数器置0
    sum = 0;         //采样点和置0
  
  //ChannelSelecion(CLOSE);  //关闭校准通道PA
    
  ChannelSelecion(TEMP_PB);
  printf("PB采样\n");
  while (s_iPointCnt <= 350) 
    {
      VB = AdDataToVoltage();  // ad值转化为电压值
    }
    printf("VB=%0.3f\n",VB);
    s_iPointCnt = 0;     //采样点计数器置0
    sum = 0;         //采样点和置0
  
  ChannelSelecion(TEMP_PA);  //打开校准通道PA
  printf("PA采样\n");
  s_iPointCnt = 0;     //采样点计数器置0
  sum = 0;         //采样点和置0  
  // 采样1100次，确保至少完成1100次采样
  while (s_iPointCnt <= 350)
    {
      VA = AdDataToVoltage();  // ad值转化为电压值
    }
    printf("VA=%0.3f\n",VA);
    s_iPointCnt = 0;     //采样点计数器置0
    sum = 0;         //采样点和置0  
    
  //ChannelSelecion(CLOSE);  //关闭校准通道PB 
  //计算体温系数
  c1 = (VB - VA) / (VA / RA - VB / RB);
  c2 = ((RA / RB) * VB - VB) / ((RA / RB) * (VB / VA) - 1);
  caflag = 0;  //校准标志位置零
  printf("校准已完成\nc1=%0.3f\nc2=%0.3f\n", c1, c2);

}

/*********************************************************************************************************
* 函数名称：BinarySearch
* 函数功能：二分法查找函数
* 输入参数：arr[]-已排序的数组 n-数组长度 target-目标值
* 输出参数：void
* 返 回 值：目标值所在的索引
* 创建日期：
* 注    意：若目标值存在返回目标值所在的索引，若目标值不存在返回与目标值最接近的索引
*********************************************************************************************************/
static u16 BinarySearch(float arr[], u16 n, float target)
{
  u16 left = 0; //左指针变量
  u16 right = n - 1;  //右指针变量
  u16 index = 0; //记录最接近目标中的索引
  float currentDiff;  //当前值和目标值的差值 
  float diff = fabs(arr[0] - target);  //记录最接近目标值的差值
  u16 mid = 0;  //数组中间索引值
  
  while(left <= right)  //当左指针变量小于或等于右指针变量时进入循环
  {
    mid = left + (right - left) / 2;  //计算中间索引
    if(arr[mid] == target)  //如果找到目标值
    {
      return mid;           //直接返回位置
    }
    
    currentDiff = fabs(arr[mid] - target);  //计算当前值和目标值的差值
    if(currentDiff < diff)   //当前差值比最近差值小时
    {
      diff = currentDiff;   //最近差值等于当前差值
      index = mid;          //记录索引
      //printf("BinarySearch-index=%d\n",index);
    }
    
    if(arr[mid] > target)  //当目标值比中间值大时，数组是从大到小排序
    {
      left = mid + 1;      //往右半部分找
    }
    else                   //当目标值比中间值小时
    {
      right = mid - 1;     //往左半部分找
    }
  }
  //printf("BinarySearch-return-index=%d\n",index);
  //没有找到目标值时，返回最接近目标值的索引
  return index;
  
}
  
/*********************************************************************************************************
*                                              API函数实现
*********************************************************************************************************/
/*********************************************************************************************************
* 函数名称: TempInit
* 函数功能: 初始化体温模块-gpio，校准
* 输入参数: void
* 输出参数: void
* 返 回 值: void
* 创建日期: 
* 注    意:
*********************************************************************************************************/
void TempInit(void)
{
  ConfigTempGPIO();  //初始化模块引脚
  c1 = (VB - VA) / (VA / RA - VB / RB);
  c2 = ((RA / RB) * VB - VB) / ((RA / RB) * (VB / VA) - 1);
}
/*********************************************************************************************************
* 函数名称: ProbeConnection
* 函数功能: 探头连接电路 
* 输入参数: 
* 输出参数: 
* 返 回 值: 1高电平-未接入 0低电平-已接入 LED反馈
* 创建日期: 
* 注    意: LED反馈
*********************************************************************************************************/
void ProbeConnection(void)
{
  static u8 lastLEDState = Bit_RESET; //上一次LED灯的状态
  printf("lead off:%d\n",leadFlag);
  DelayNms(2);
  if(GPIO_ReadInputDataBit(GPIOC, SENS_OFF))    //未接入探头时是高电平
  {
    if(lastLEDState != Bit_RESET)  //导联状态发生变化时修改gpio
    {
      GPIO_WriteBit(GPIOC, GPIO_Pin_5, Bit_RESET);          //将LED2的状态设置为熄灭
      printf("探头未接入\n");
      lastLEDState = Bit_RESET;
    }
    leadFlag = 1; //将导联脱落标志位置1 已脱离
  }
  
  else  //接入探头时是低电平，点亮LED2
  {
    if(lastLEDState != Bit_SET)
    {
      GPIO_WriteBit(GPIOC, GPIO_Pin_5, Bit_SET);          //将LED2的状态设置为点亮
      lastLEDState = Bit_SET;
    }
    leadFlag = 0;  //将导联脱落标志位置0 未脱离
  }
  printf("lead off:%d\n",leadFlag);
}
/*********************************************************************************************************
* 函数名称: TempVal
* 函数功能: 计算体温
* 输入参数: void
* 输出参数: void
* 返 回 值: 
* 创建日期: 
* 注    意:体温精度为0.1℃，把计算得到的电阻与数组的值比较，若有相等的值就返回相应值的索引，若没有相等的值，
返回与电阻相差最小值的索引
*********************************************************************************************************/
float TempVal(void)
{
  float v;  //voltage-电压 R-电阻值
  float Temp;   //温度
  static float lastTemp; //上一次的温度
  u16 index;  //温度数组索引  
  
  if(leadFlag == 0 && openFlag == 1) //导联脱离标志位为0 开启体温标志位为1时计算体温
  {
    printf("S1采样\n");
    s_iPointCnt = 0;     //采样点置0
    sum = 0;         //采样点的和，用于计算平均值
    while (leadFlag == 0 && openFlag == 1 && s_iPointCnt < 350) //采样点数大于1100和迭代次数大于最大值 防止卡在while
    {
      v = AdDataToVoltage();  // ad值转化为电压值
    }
    
    printf("v=%0.3f -TempVal\n",v);  //体温电压值
    s_iPointCnt = 0;     //采样点置0
    sum = 0;         //采样点的和，用于计算平均值
    
    R = c1 * v / (c2 - v);  //计算电阻值
    
    //printf("原始电阻值R:%0.2f\n", R);
    //R = (R+22.7) / 0.948;  //计算电阻值      
    R = (R - 15.2197) / 0.9230;
    //printf("加上偏差电阻的电阻值R:%0.2f\n", R);
  
   //公式带入，或二分法查数组
    index = BinarySearch(arr_R, n, R);     //查找电阻索引
    printf("index=%d   ",index);
    Temp = index + 1;    //温度=阻值下标/10+1
    lastTemp = Temp;
    printf("  temp=%0.2f\n",Temp);
    
    return Temp;
  }
  else
  {
    return lastTemp;
  }
}

/*********************************************************************************************************
* 函数名称: SetTempChannel
* 函数功能: 设置体温通道
* 输入参数: type-体温通道
* 输出参数: 
* 返 回 值: 
* 创建日期: 
* 注    意:
*********************************************************************************************************/
void SetTempChannel(u8 type)
{
  ChannelSelecion(type);
}

/*********************************************************************************************************
* 函数名称: GetTempChannel
* 函数功能: 获得体温通道
* 输入参数: 
* 输出参数: 
* 返 回 值: 
* 创建日期: 
* 注    意:返回state，channel
*********************************************************************************************************/
//u8 GetTempChannel(void)
//{
//  
//  
//}
/*********************************************************************************************************
* 函数名称: TempAdjusting
* 函数功能: 体温校准
* 输入参数: void
* 输出参数: void
* 返 回 值: void
* 创建日期: 
* 注    意:
*********************************************************************************************************/
void TempAdjusting(void)
{
  TempCalibration();
  SetTempChannel(TEMP_SENSE1);
  //SetTempChannel(TEMP_PA);
}
/*********************************************************************************************************
* 函数名称: ShowTemp
* 函数功能: OLED显示体温
* 输入参数: temp-体温值
* 输出参数: void
* 返 回 值: void
* 创建日期: 
* 注    意:
*********************************************************************************************************/
void ShowTemp(float temp, int r)
{
  u8 i;  //十位和个位
  u8 j;  //小数点后一位
  u32 show_c1;
  u32 show_c2;
  float decimal_part;
  char state[10] = "state";    //状态字符串
  char channel[10] = "channel";//通道字符串
  i = temp / 10;  //取整
  j = (int)temp % 10;  //取余
  
  
//  printf("lead off:%d\n",leadFlag);
//  printf("caflag:%d\n",caflag);
//  printf("openFlag:%d\n",openFlag);
  
  if(openFlag == 1 && leadFlag == 0 && caflag == 0)  //体温测量开启
  {
    strcpy(state, "open     ");
    strcpy(channel, "SENSE1");
  }
  else if(leadFlag == 1 )  //导联脱落状态
  {
    strcpy(state, "lead off   ");
    strcpy(channel, "--     ");
  }
  //printf("OLED updated with state: %s\n", state);
  //显示状态和当前通道
  OLEDShowString(0, 0, "Tempareture:");
  OLEDShowString(0, 16, "State:");
  OLEDShowString(48, 16, state);
//  OLEDShowString(0, 32, "Channel:");
//  OLEDShowString(64, 32, channel);
//  OLEDShowString(0, 32, "R:");
  OLEDShowString(0, 32, "C1:");
  OLEDShowString(0, 48, "C2:");

 
  //显示体温
  OLEDShowNum(100,0,i,2,16);  //OLED显示十位和个位
  OLEDShowString(116, 0, ".");  //显示小数点
  OLEDShowNum(120,0,j,1,16);  //OLED显示小数点后一位
  
  //显示电阻
//  OLEDShowNum(16,32,r/100000,1,16);  //OLED显示千位
//  OLEDShowNum(24,32, (r%100000)/10000,1,16);  //百位
//  OLEDShowNum(32,32,(r%10000)/1000,1,16);  //十位
//  OLEDShowNum(40,32,(r%1000)/100,1,16);  //个位
//  OLEDShowString(48, 32, ".");  //显示小数点
//  OLEDShowNum(56,32,(r%100)/10,1,16);  //个位
  //显示体温系数c1，c2
  decimal_part = c1 - (int)c1;
  OLEDShowNum(24,32,c1/10000,1,16);  //OLED显示万位
  OLEDShowNum(32,32, ((int)c1%10000)/1000,1,16);  //千位
  OLEDShowNum(40,32,((int)c1%1000)/100,1,16);  //百位
  OLEDShowNum(48,32,((int)c1%100)/10,1,16);  //十位
  OLEDShowNum(56,32,(int)c1%10,1,16);  //个位
  OLEDShowString(64, 32, ".");  //显示小数点
  OLEDShowNum(72,32,decimal_part*100,2,16);  //个位
  
  show_c2 = c2*100;
  OLEDShowNum(24,46,(show_c2%1000)/100,1,16);  //个位
  OLEDShowString(32, 46, ".");  //显示小数点
  OLEDShowNum(40,46,(show_c2%100)/10,1,16);  //个位
  OLEDShowNum(48,46,show_c2%10,1,16);  //个位

  OLEDRefreshGRAM();  //刷新OLED
  
}

/*********************************************************************************************************
* 函数名称: SetCalibrateFlag
* 函数功能: 设置采样标志位
* 输入参数: u8 flag
* 输出参数: caflag
* 返 回 值: void
* 创建日期: 
* 注    意:
*********************************************************************************************************/
void SetCalibrateFlag(u8 flag)
{
  caflag = flag;
}

/*********************************************************************************************************
* 函数名称: GetCalibrateFlag
* 函数功能: 获得采样标志位
* 输入参数: void
* 输出参数: void
* 返 回 值: caflag
* 创建日期: 
* 注    意:
*********************************************************************************************************/
u8 GetCalibrateFlag()
{
  return caflag;
}
